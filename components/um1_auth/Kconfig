## components/um1_auth/Kconfig
```kconfig
menu "Token Auth (HTTPD)"
config TOKEN_AUTH_ENABLED
    bool "Enable Token-based Auth"
    default y

config TOKEN_AUTH_TTL_SEC
    int "Token TTL (seconds)"
    range 60 86400
    default 28800  # 8 hours
endmenu
```
